## conf/layer.conf
```bitbake
# We have a conf and classes directory, add to BBPATH
BBPATH .= ":${LAYERDIR}"

# We have recipes-* directories, add to BBFILES
BBFILES += "${LAYERDIR}/recipes-*/*/*.bb \
            ${LAYERDIR}/recipes-*/*/*.bbappend"

BBFILE_COLLECTIONS += "meta-clearfog"
BBFILE_PATTERN_meta-clearfog = "^${LAYERDIR}/"
BBFILE_PRIORITY_meta-clearfog = "10"

LAYERSERIES_COMPAT_meta-clearfog = "rocko sumo thud"
```

## conf/machine/clearfog-base.conf
```bitbake
#@TYPE: Machine
#@NAME: SolidRun ClearFog Base
#@SOC: Armada 38x
#@DESCRIPTION: Machine configuration for SolidRun ClearFog Base

KERNEL_DEVICETREE = "armada-388-clearfog-base.dtb"

IMAGE_BOOT_FILES = "zImage armada-388-clearfog-base.dtb boot.scr"

IMAGE_FSTYPES = "tar.bz2 ext4 wic.gz"

require conf/machine/include/clearfog-common.inc
```

## conf/machine/clearfog-pro.conf
```bitbake
#@TYPE: Machine
#@NAME: SolidRun ClearFog Pro
#@SOC: Armada 38x
#@DESCRIPTION: Machine configuration for SolidRun ClearFog Pro

KERNEL_DEVICETREE = "armada-388-clearfog-pro.dtb"

IMAGE_BOOT_FILES = "zImage armada-388-clearfog-pro.dtb boot.scr"

IMAGE_FSTYPES = "tar.bz2 ext4 wic.gz"

require conf/machine/include/clearfog-common.inc
```

## conf/machine/include/clearfog-common.inc
```bitbake
require conf/machine/include/tune-cortexa9.inc

MACHINEOVERRIDES =. "clearfog:"

KERNEL_IMAGETYPE = "zImage"
PREFERRED_PROVIDER_virtual/kernel ?= "linux-stable"

# Depending on which boot medium is selected the U-boot binary will change name
#
#    u-boot-spl-mmc.kwb
#    u-boot-spl-nand.kwb"
#    u-boot-spl-sata.kwb"
#    u-boot-spl-sdhc.kwb"
#    u-boot-spl-spi.kwb
#
# Update this variable to change boot location, it will update
# MVEBU_SPL_BOOT_DEVICE_XXX
UBOOT_BINARY ?= "u-boot-spl-sdhc.kwb"
UBOOT_MACHINE = "clearfog_defconfig"

PREFERRED_PROVIDER_virtual/bootloader ?= "u-boot-solidrun-a38x"
PREFERRED_PROVIDER_u-boot-fw-utils ?= "u-boot-solidrun-a38x-fw-utils"
PREFERRED_RPROVIDER_u-boot-fw-utils ?= "u-boot-solidrun-a38x-fw-utils"
PREFERRED_PROVIDER_u-boot-tools-native ?= "u-boot-solidrun-a38x-tools-native"

MACHINE_ESSENTIAL_EXTRA_RDEPENDS += " \
    kernel-image \
    kernel-devicetree \
"

MACHINE_EXTRA_RRECOMMENDS += "kernel-modules"

SERIAL_CONSOLE = "115200 ttyS0"

MACHINE_FEATURES = "ext2 ext3 ipsec nfs pci smbfs usbgadget usbhost vfat"

WKS_FILE = "clearfog.wks"
WKS_FILE_DEPENDS = "virtual/bootloader clearfog-u-boot-scr"
```
